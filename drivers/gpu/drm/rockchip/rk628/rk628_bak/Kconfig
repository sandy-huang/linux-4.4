## drivers/gpu/drm/rockchip/rk628/rk628_bak/Kconfig
```kconfig
# SPDX-License-Identifier: GPL-2.0

config DRM_ROCKCHIP_RK628
	tristate "Rockchip rk628 display bridge driver"
	depends on DRM_ROCKCHIP
#depends on MFD_RK628
	select DRM_PANEL
	---help---
	  Rockchip rk628 display bridge chips driver.
```
